## drivers/media/video/samsung/fimc/Kconfig
```kconfig
config VIDEO_FIMC
	bool "Samsung Camera Interface (FIMC) driver"
	depends on VIDEO_SAMSUNG && ARCH_S5PV210
	default n
	help
	  This is a video4linux driver for Samsung FIMC device.


config VIDEO_OV3640
        bool "camera ov3640"
        depends on VIDEO_FIMC
        help
          camera ov3640 for TQ210
config VIDEO_OV9650
        bool "camera ov9650"
        depends on VIDEO_FIMC
        help
          camera ov9650 for TQ210

config VIDEO_TVP5150
        bool "camera tvp5150"
        depends on VIDEO_FIMC
        help
          camera tvp5150 for TQ210
config VIDEO_SAA7113
        bool "camera saa7113"
        depends on VIDEO_FIMC
        help
          camera saa7113 for TQ210

choice
depends on VIDEO_FIMC
prompt "Select CSC Range config"
default VIDEO_FIMC_RANGE_NARROW
config VIDEO_FIMC_RANGE_NARROW
	bool "Narrow"
	depends on VIDEO_FIMC && ARCH_S5PV210
	---help---
	  RGB <-> YUV Color Conversion Narrow Range Equation

config VIDEO_FIMC_RANGE_WIDE
	bool "Wide"
	depends on VIDEO_FIMC && ARCH_S5PV210
	---help---
	  RGB <-> YUV Color Conversion Wide Range Equation
endchoice	

config VIDEO_FIMC_DEBUG
	bool "FIMC driver debug messages"
	depends on VIDEO_FIMC

config VIDEO_FIMC_MIPI
	bool "MIPI-CSI2 Slave Interface support"
	depends on VIDEO_FIMC && ARCH_S5PV210
	default y
```

## drivers/video/samsung/Kconfig
```kconfig
#
# S3C Video configuration
#

config FB_S3C
	tristate "S3C Framebuffer support"
	select FB_CFB_FILLRECT
	select FB_CFB_COPYAREA
	select FB_CFB_IMAGEBLIT
	depends on FB && ARCH_S5PV210
	default n
	---help---
	  This enables support for Samsung Display Controller (FIMD)

config FB_S3C_SPLASH_SCREEN
        bool "SPLASH_SCREEN on LCD"
        depends on FB_S3C
	default n

config FB_S3C_LCD_INIT
        bool "LCD init in kernel"
        depends on FB_S3C
	default y

config FB_S3C_DEBUG
        bool "S3C Framebuffer debug messages"
        depends on FB_S3C

config FB_S3C_TRACE_UNDERRUN
	bool "S3C Framebuffer FIFO underrun trace"
	depends on FB_S3C

config FB_S3C_DEFAULT_WINDOW
	int "Default Window (0-4)"
	range 0 4
	depends on FB_S3C
	default "2"
	---help---
	  This indicates the default window number, and which is used as console framebuffer

config FB_S3C_NR_BUFFERS
	int "Number of frame buffers (1-3)"
	depends on FB_S3C
	default "2"
	---help---
	  This indicates the number of buffers for pan display,
	  1 means no pan display and
	  2 means the double size of video buffer will be allocated for default window

config FB_S3C_NUM_OVLY_WIN
	int "Number of overlay window (0-3)"
	range 0 3
	depends on FB_S3C
	default "1"
	---help---
	  This indicates the number of overlay windows for video rendering

config FB_S3C_NUM_BUF_OVLY_WIN
	int "Number of buffers for overlay window (2-3)"
	range 2 3
	depends on FB_S3C
	default "3"
	---help---
	  This indicates the number of buffers for overlay windows

config FB_S3C_VIRTUAL
	bool "Virtual Screen"
	depends on FB_S3C
	default n
	---help---
	  This uses 1920 x 1080 virtual screen.

config FB_S3C_X_VRES
	int "xres_virtual"
	depends on FB_S3C && FB_S3C_VIRTUAL
	default "1920"
	help
	  This indicates var.xres_virtual which has to be bigger than var.xres.

config FB_S3C_Y_VRES
	int "yres_virtual"
	depends on FB_S3C && FB_S3C_VIRTUAL
	default "1080"
	help
	  This indicates var.yres_virtual which has to be bigger than var.yres.

config VIDEO_SAMSUNG_MEMSIZE_FIMD
	int "Memory size in kbytes for FIMD"
	depends on FB_S3C
	default "3072"

choice
depends on FB_S3C
prompt "Select LCD Type"
default FB_TQ_AUTO_DETECT
config FB_TQ_AUTO_DETECT
	bool "for TQ210-LCD auto detect"
	depends on (MACH_TQ210 || MACH_SMDKV210 || MACH_SMDKC110)
	---help---
	  This enables support for Samsung fb auto detect
	  
config FB_S3C_LCD480X272_T43
	bool "TQ210-LCD480*272 for 4.3-inch screen"
	depends on MACH_SMDKV210 || MACH_SMDKC110 ||MACH_TQ210
	select BACKLIGHT_PWM
	help
	  This enables support for TQ210 T43 LCD panel
	  

config FB_S3C_LCD800X480_A70
	bool "TQ210-LCD800*480 for 7-inch sreen AT070TN92"
	depends on MACH_SMDKV210 || MACH_SMDKC110 ||MACH_TQ210
	select BACKLIGHT_PWM
	help
	  This enables support for TQ210-LCD800*480 AT070TN92 WVGA LCD panel
  	  
config FB_S3C_LCD800X600_A104
	bool "TQ210-LCD800*600 for 10.4-inch screen"
	depends on MACH_SMDKV210 || MACH_SMDKC110 ||MACH_TQ210
	select BACKLIGHT_PWM
	help
	  This enables support for TQ210 T10 4.8\" WVGA LCD panel

config FB_S3C_VGA1024X768
	bool "TQ210-VGA1024*768"
	depends on MACH_SMDKV210 || MACH_SMDKC110 ||MACH_TQ210
	select BACKLIGHT_PWM
	help
	  This enables support for TQ210 4.8\" WVGA LCD panel

endchoice

config FB_S3C_NT35580
        bool "NT35580"
        depends on FB_S3C
        select SPI
        select SPI_GPIO
        select SPI_BITBANG
        ---help---
          This enables support for SONY NT35580 WVGA LCD panel

config FB_S3C_LVDS
	bool "LVDS"
	depends on FB_S3C && (ARCH_S5PV210)
	default y
	---help---
	  This enables support for Samsung LVDS LCD panel

config FB_S3C_AMS701KA
	bool "AMS701KA"
	depends on FB_S3C && (ARCH_S5PV210)
	select SPI
	select SPI_GPIO
	default n
	---help---
	  This enables support for Samsung AMS701KA LCD panel

config FB_S3C_MDNIE
	bool "Samsung MDNIE"
	depends on FB_S3C
	depends on FB_S3C && (ARCH_S5PV210)
	default "0"
	---help---
	  This enables support for Samsung MDNIE feature

config FB_S3C_CMC623
	bool "Samsung CMC623"
	depends on FB_S3C && (ARCH_S5PV210)
	default "0"
	---help---
	This enables support for Samsung CMC623 feature
```
